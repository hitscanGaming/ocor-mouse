## applications/gaming_mouse/Kconfig
```kconfig
#
# Copyright (c) 2018 Nordic Semiconductor ASA
#
# SPDX-License-Identifier: LicenseRef-Nordic-5-Clause
#

menu "nRF Desktop"

config DESKTOP_HID
	bool "Enable HID Desktop support"
	default n
	help
	  Enable support for the nRF Desktop HID role.

if DESKTOP_HID
rsource "Kconfig.hid"
endif

rsource "Kconfig.ble"
rsource "Kconfig.debug"
rsource "src/events/Kconfig"
rsource "src/hw_interface/Kconfig"
rsource "src/modules/Kconfig"
rsource "src/util/Kconfig"
rsource "Kconfig.defaults"
endmenu

menu "Zephyr Kernel"
source "Kconfig.zephyr"
endmenu
```

## applications/gaming_mouse/boards/nordic/hitscan/hitscan_defconfig
```kconfig
CONFIG_ARM_MPU=y
CONFIG_HW_STACK_PROTECTION=y

CONFIG_USE_SEGGER_RTT=y

# bootloader
```

## applications/gaming_mouse/src/hw_interface/Kconfig.polling_rate
```kconfig
#
# Copyright (c) 2025 Nordic Semiconductor ASA
#
# SPDX-License-Identifier: LicenseRef-Nordic-5-Clause
#

menuconfig POLLING_RATE_ENABLE
	bool "Enable polling rate timer module"
	default y if DESKTOP_MOTION_SENSOR_ENABLE
	default y if DESKTOP_SPI_MASTER
	help
	  Enable the polling rate timer module for high-frequency
	  sensor polling using hardware counters. Required by spi_master.c
	  (the dongle's SPI HID forwarder) which calls polling_rate_init/start
	  unconditionally.

if POLLING_RATE_ENABLE

config POLLING_RATE_TIMER_LABEL
	string "Devicetree node label for timer"
	default "timer3"
	help
	  Devicetree node label for the counter/timer device used
	  for polling rate generation.

config POLLING_RATE_DEFAULT_HZ
	int "Default polling rate (Hz)"
	default 1000
	range 125 8000
	help
	  Default polling rate in Hz.

config POLLING_RATE_MIN_HZ
	int "Minimum polling rate (Hz)"
	default 125
	range 1 1000
	help
	  Minimum allowed polling rate in Hz.

config POLLING_RATE_MAX_HZ
	int "Maximum polling rate (Hz)"
	default 8000
	range 1000 16000
	help
	  Maximum allowed polling rate in Hz.

endif # POLLING_RATE_ENABLE
```

## applications/gaming_mouse/src/modules/Kconfig.esb
```kconfig
# Kconfig.esb
#
# Copyright (c) 2019 Nordic Semiconductor
#
# SPDX-License-Identifier: LicenseRef-Nordic-5-Clause
#

menu "ESB configuration"

choice
	prompt "Select ESB interface"
	default DESKTOP_ESB_NONE

config DESKTOP_ESB_NONE
	bool "Disable ESB"
	help
	  ESB module is not used.

config DESKTOP_ESB_RX_ENABLE
	bool "ESB RX"
	select DESKTOP_ESB_ENABLE
	help
	  If selected, esb RX interface is enabled.

config DESKTOP_ESB_TX_ENABLE
	bool "ESB TX"
	select DESKTOP_ESB_ENABLE
	help
	  If selected, esb TX interface is enabled.

endchoice

config DESKTOP_ESB_ENABLE
	bool
	select ESB
	select APP_EVENT_MANAGER
	select CLOCK_CONTROL
	help
	  Hidden option selected by RX or TX enable.

rsource "Kconfig.esb_tx"
rsource "Kconfig.esb_rx"

endmenu
```

## applications/gaming_mouse/src/modules/Kconfig.esb_tx
```kconfig
# Kconfig.esb_tx

if DESKTOP_ESB_TX_ENABLE

config DESKTOP_ESB_SUBSCRIBER_REPORT_PRIORITY
	int "ESB HID reports subscriber priority"
	default 100
	range 1 255
	help
	  ESB reports subscriber priority. The lower value means the lower
	  priority in subscription to HID reports. By default, the ESB uses the highest
	  possible priority.

config DESKTOP_ESB_TX_ACK_INTERVAL_MS
	int "ACK Interval (ms)"
	default 100
	help
	  Interval in milliseconds to request an ACK from the host.
	  This is used to check for configuration data sent from the host.


config DESKTOP_CONFIG_CHANNEL_ENABLE
	bool "Enable Desktop Config Channel"
	default y
	help
	  Enables the configuration channel (WebHID) transport over ESB.

# -----------------------------------------------------------------------------
# Module Log Levels
# -----------------------------------------------------------------------------

module = ESB_DRIVER
module-str = ESB Driver
source "subsys/logging/Kconfig.template.log_config"

module = ESB_STATE
module-str = ESB State Manager
source "subsys/logging/Kconfig.template.log_config"

module = ESB_STATE_PM
module-str = ESB Power Manager
source "subsys/logging/Kconfig.template.log_config"

endif # DESKTOP_ESB_TX_ENABLE
```

## applications/gaming_mouse/src/modules/Kconfig.spi_master
```kconfig
#
# Copyright (c) 2024 Nordic Semiconductor ASA
#
# SPDX-License-Identifier: LicenseRef-Nordic-5-Clause
#

menuconfig DESKTOP_SPI_MASTER
	bool "SPI master module"
	default n
	help
	  This option enable spi master module.

if DESKTOP_SPI_MASTER

config DESKTOP_SPI_INTERRUPT_PIN
	int "SPI interrupt pin number"
	default 255
	help
	  Pin number for SPI interrupt.



module = DESKTOP_SPI_MASTER
module-str = SPI_MASTER
source "subsys/logging/Kconfig.template.log_config"



endif # DESKTOP_SPI_MASTER
```

## applications/gaming_mouse/src/modules/Kconfig.userpin
```kconfig
#
# Copyright (c) 2024 Nordic Semiconductor ASA
#
# SPDX-License-Identifier: LicenseRef-Nordic-5-Clause
#

menuconfig DESKTOP_USERPIN
	bool "User pin module"
	default n
	help
	  This option enable userpin module.

if DESKTOP_USERPIN

module = DESKTOP_USERPIN
module-str = USERPIN
source "subsys/logging/Kconfig.template.log_config"



endif # DESKTOP_USERPIN
```

## west.yml
```yaml
manifest:
  version: "1.0"
  remotes:
    - name: ncs
      url-base: https://github.com/nrfconnect
  projects:
    - name: sdk-nrf
      remote: ncs
      revision: v3.0.2
      path: nrf
      import:
        # pull nrf's manifest deps (zephyr, mcuboot, nrfxlib, etc.) for reproducible builds
        name-allowlist:
          - zephyr
          - nrfxlib
          - mcuboot
          - cmsis
          - hal_nordic
          - segger
          - tinycrypt
          - mbedtls
          - psa-arch-tests
          - tf-m-tests
          - trusted-firmware-m
```
